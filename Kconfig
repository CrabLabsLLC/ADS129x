## Kconfig
```kconfig
# Copyright (c) 2025 Makani Science
# SPDX-License-Identifier: Apache-2.0

menuconfig ADS1293
	bool "ADS1293 ECG Analog Front-End driver"
	default y
	depends on DT_HAS_TI_ADS1293_ENABLED
	depends on SPI
	select GPIO
	help
	  Enable driver for Texas Instruments ADS1293 3-channel, 24-bit
	  low-power analog front-end for ECG applications.

if ADS1293

config ADS1293_INIT_PRIORITY
	int "ADS1293 initialization priority"
	default 90
	help
	  Device initialization priority for ADS1293.
	  Should be higher than SPI bus priority.

config ADS1293_LOG_LEVEL
	int "ADS1293 log level"
	default 3
	range 0 4
	help
	  Sets log level for ADS1293 driver.
	  0 = OFF, 1 = ERR, 2 = WRN, 3 = INF, 4 = DBG

config ADS1293_LEAD_OFF_DETECTION
	bool "Enable lead-off detection"
	default y
	help
	  Enable electrode lead-off detection feature.
	  Useful for detecting disconnected electrodes.

config ADS1293_LEAD_OFF_AC_ENABLE
	bool "Enable AC lead-off detection"
	default n
	help
	  Enable AC lead-off detection mode (in addition to DC if enabled).
	  Reset value is disabled.

config ADS1293_LEAD_OFF_THRESHOLD
	int "Lead-off comparator threshold (0-7)"
	range 0 7
	default 0
	help
	  Lead-off comparator threshold. Reset value is 0.

config ADS1293_LEAD_OFF_CURRENT
	hex "Lead-off detection current"
	range 0x0 0xff
	default 0x00
	help
	  Lead-off detection current magnitude (register value).
	  Reset value is 0x00.

config ADS1293_LEAD_OFF_INPUT_MASK
	hex "Lead-off input mask"
	range 0x0 0xff
	default 0x00
	help
	  Bitmask of inputs to monitor for lead-off detection.
	  Reset value is 0x00.

config ADS1293_RLD_ENABLE
	bool "Enable Right Leg Drive"
	default y
	help
	  Enable the Right Leg Drive (RLD) amplifier for
	  common-mode noise rejection.

config ADS1293_SAMPLE_RATE
	int "Default sample rate (Hz)"
	default 256
	range 50 1024
	help
	  Default ECG sample rate in Hz.
	  The driver calculates the closest achievable rate using the
	  R1, R2, R3 decimation factors.

	  Common values:
	    256 Hz (default) - standard ECG
	    512 Hz - higher resolution
	    1024 Hz - maximum resolution

	  Actual rate depends on clock source (internal or external).

config ADS1293_HIRES_MASK
	hex "AFE high-resolution enable mask (EN_HIRES_CHx)"
	default 0x0
	range 0x0 0x7
	help
	  Bitmask enabling high-resolution mode per channel in AFE_RES.
	  Bit 0 = CH1, bit 1 = CH2, bit 2 = CH3. Reset value is 0.

config ADS1293_FS_HIGH_MASK
	hex "AFE high-frequency clock mask (FS_HIGH_CHx)"
	default 0x0
	range 0x0 0x7
	help
	  Bitmask enabling 204.8 kHz modulator clock per channel in AFE_RES.
	  Bit 0 = CH1, bit 1 = CH2, bit 2 = CH3. Reset value is 0.

config ADS1293_DRDY_IRQ_ENABLE
	bool "Enable DRDY interrupt GPIO support"
	default y
	help
	  Enable support for the DRDY (Data Ready) pin interrupt functionality.
	  When disabled, the driver will not configure or use the DRDY GPIO
	  for interrupts even if specified in devicetree. Use polling instead.
	  Disable this if the DRDY pin is not connected or not needed.

config ADS1293_ALARM_IRQ_ENABLE
	bool "Enable ALARM interrupt GPIO support"
	default y
	help
	  Enable support for the ALARM pin interrupt functionality.
	  When disabled, the driver will not configure or use the ALARM GPIO
	  for interrupts even if specified in devicetree.
	  Disable this if the ALARM pin is not connected or not needed.

endif # ADS1293
```

## dts/bindings/sensor/ti,ads1293.yaml
```yaml
# Copyright (c) 2025 Makani Science
# SPDX-License-Identifier: Apache-2.0

description: |
  Texas Instruments ADS1293 3-Channel, 24-Bit ECG Analog Front-End

  The ADS1293 is a low-power, 3-channel, 24-bit analog front-end
  designed for biopotential measurements such as ECG applications.
  It features flexible input routing, programmable sample rates,
  lead-off detection, and right leg drive.

  Clock Source Configuration:
  The ADS1293 requires a clock source, which can be either:
    1. Internal oscillator - Uses the chip's built-in 204.8 kHz oscillator
    2. MCU-provided clock - PWM output connected to the chip's CLKIN pin

  If the pwms property is present with a "clkin" name, the driver uses
  MCU-provided clock via PWM. Otherwise, it uses the internal oscillator.

  Example with internal oscillator (default):

    &spi0 {
      ads1293: ads1293@0 {
        compatible = "ti,ads1293";
        reg = <0>;
        spi-max-frequency = <4000000>;
        drdy-gpios = <&gpio0 10 GPIO_ACTIVE_LOW>;
        reset-gpios = <&gpio0 12 GPIO_ACTIVE_LOW>;
      };
    };

  Example with MCU-provided clock via PWM:

    &spi0 {
      ads1293: ads1293@0 {
        compatible = "ti,ads1293";
        reg = <0>;
        spi-max-frequency = <4000000>;
        drdy-gpios = <&gpio0 10 GPIO_ACTIVE_LOW>;
        reset-gpios = <&gpio0 12 GPIO_ACTIVE_LOW>;
        pwms = <&pwm0 0 PWM_HZ(204800) PWM_POLARITY_NORMAL>;
        pwm-names = "clkin";
      };
    };

compatible: "ti,ads1293"

include: spi-device.yaml

properties:
  drdy-gpios:
    type: phandle-array
    required: true
    description: |
      GPIO connected to the DRDYB (Data Ready) pin.
      This pin goes low when new ECG data is available.
      Active-low signal.

  alarm-gpios:
    type: phandle-array
    description: |
      GPIO connected to the ALARMB pin.
      This pin indicates error conditions such as lead-off
      detection or out-of-range signals.
      Active-low signal.

  reset-gpios:
    type: phandle-array
    description: |
      GPIO connected to the RESETB pin.
      Used for hardware reset of the device.
      Active-low signal.

      If not provided, software must ensure proper power-on
      reset timing.

  pwms:
    type: phandle-array
    description: |
      PWM channel used to generate the clock signal for the
      ADS1293 CLKIN pin.

      When this property is present, the driver configures the
      PWM to output a 50% duty cycle clock at the frequency
      specified in the PWM specifier.

      The ADS1293 supports clock frequencies from 128 kHz to
      512 kHz. The internal oscillator frequency is 204.8 kHz.

      If this property is absent, the driver uses the internal
      oscillator.

      Example for 204.8 kHz clock:
        pwms = <&pwm0 0 PWM_HZ(204800) PWM_POLARITY_NORMAL>;
        pwm-names = "clkin";

  pwm-names:
    type: string-array
    description: |
      Names for the PWM channels. Should be "clkin" for the clock input.

  vin-supply:
    type: phandle
    description: |
      Reference to the regulator that supplies power to the device.
      Used for power management.

  # =========================================================================
  # Per-Channel Input Routing
  # =========================================================================
  # The ADS1293 has 3 ECG channels and 6 physical inputs (IN1-IN6).
  # Each channel measures a differential voltage between two inputs.
  # This routing is HARDWARE-SPECIFIC and depends on PCB electrode wiring.
  #
  # Input values match the physical pin names:
  #   0 = NC  (not connected - disables this input)
  #   1 = IN1 (typically RA - Right Arm)
  #   2 = IN2 (typically LA - Left Arm)
  #   3 = IN3 (typically LL - Left Leg)
  #   4 = IN4 (typically RL - Right Leg / Reference)
  #   5 = IN5 (typically V1 precordial)
  #   6 = IN6 (Wilson Central Terminal or precordial)
  #
  # Configuration Options:
  #
  # 1. Standard bipolar leads (Lead I, II, III):
  #      ch1-inputs = <2 1>;  /* LA - RA = Lead I   */
  #      ch2-inputs = <3 1>;  /* LL - RA = Lead II  */
  #      ch3-inputs = <3 2>;  /* LL - LA = Lead III */
  #
  # 2. Wilson Central Terminal reference (recommended for cleaner signals):
  #    Route Wilson terminal to IN6, then use IN6 as common reference:
  #      ch1-inputs = <1 6>;  /* IN1 - WCT = unipolar RA */
  #      ch2-inputs = <2 6>;  /* IN2 - WCT = unipolar LA */
  #      ch3-inputs = <3 6>;  /* IN3 - WCT = unipolar LL */
  #    Benefits: Better noise rejection, cleaner unipolar signals
  # =========================================================================

  ch1-inputs:
    type: array
    description: |
      Channel 1 differential input routing: <positive negative>

      Specifies which physical inputs connect to Channel 1.
      Format: <INx_positive INx_negative> where x is 0-6.

      Input values (match physical pin names):
        0 = NC  (not connected)
        1 = IN1 (typically RA - Right Arm)
        2 = IN2 (typically LA - Left Arm)
        3 = IN3 (typically LL - Left Leg)
        4 = IN4 (typically RL / Reference)
        5 = IN5 (typically V1 precordial)
        6 = IN6 (typically V2 precordial)

      Example for Lead I (LA - RA):
        ch1-inputs = <2 1>;  /* IN2(+) - IN1(-) */

      Default: <2 1> (IN2 - IN1 = Lead I)

  ch2-inputs:
    type: array
    description: |
      Channel 2 differential input routing: <positive negative>

      Specifies which physical inputs connect to Channel 2.
      Format: <INx_positive INx_negative> where x is 0-6.

      Example for Lead II (LL - RA):
        ch2-inputs = <3 1>;  /* IN3(+) - IN1(-) */

      Default: <3 1> (IN3 - IN1 = Lead II)

  ch3-inputs:
    type: array
    description: |
      Channel 3 differential input routing: <positive negative>

      Specifies which physical inputs connect to Channel 3.
      Format: <INx_positive INx_negative> where x is 0-6.

      Example for Lead III (LL - LA):
        ch3-inputs = <3 2>;  /* IN3(+) - IN2(-) */

      Default: <3 2> (IN3 - IN2 = Lead III)

      Note: Sample rate and lead-off detection are configured via Kconfig
      (CONFIG_ADS1293_SAMPLE_RATE, CONFIG_ADS1293_LEAD_OFF_DETECTION) as
      they are runtime/build-time settings, not hardware-specific.
```
